## ESP32-Sniffer(Wi-Fi)/otawifi/main/Kconfig.projbuild
```kconfig
menu "Custom Configuration"

	config OTA_WIFI_SSID
		string "WiFi SSID"
		default "myssid"
		help
		SSID (network name) for the example to connect to.

	config OTA_WIFI_PASSWORD
		string "WiFi Password"
		default "mypassword"
		help
		WiFi password (WPA or WPA2) for the example to use.

	config ESP_MAXIMUM_RETRY
		int "Maximum retry"
		default 20
		help
		Set the Maximum retry to avoid station reconnecting to the AP unlimited when the AP is really inexistent. 
		
	config SNIFFER_CHANNEL
        int "Sniffer Channel"
        default 1
		help
			The channel of sniffer.

    config FIRMWARE_UPG_URL
        string "HTTP Server URL"
        default "https://192.168.0.3:8070/hello-world.bin"
        help
            HTTP Server IP to download the image file from.

            See example README.md for details.
	
	config SOCKET_DEST_IP
        string "Socket Dest IP"
        default "127.0.0.1"
		help
			Set Socket sever IP address. 
			
    config GPIO_DIAGNOSTIC
        int "Number of the GPIO input for diagnostic"
        range 0 39
        default 4
        help
            Used to demonstrate how a rollback works.
            The selected GPIO will be configured as an input with internal pull-up enabled.
            To trigger a rollback, this GPIO must be pulled low while the message
            `Diagnostics (5 sec)...` which will be on first boot.
            If GPIO is not pulled low then the operable of the app will be confirmed.
			
endmenu
```
